## arch/arc/plat-aml8626x/Kconfig
```kconfig
#
# Copyright (C) 2012 Synopsys, Inc. (www.synopsys.com)
#
# This program is free software; you can redistribute it and/or modify
# it under the terms of the GNU General Public License version 2 as
# published by the Free Software Foundation.
#


config AM_INTC
	bool "Off-core Amlogic Interrupt Controller"
	default n
	help
	  This is the off-core(2nd level) Interrupt Controller which can
	  be used to cascade external interrupts. It provides lot of
	  fancy features such as IRQ priority, Masking, Disabling....

source arch/arc/drivers/Kconfig
```

## arch/arc/plat-eznps/Kconfig
```kconfig
# For a description of the syntax of this configuration file,
# see Documentation/kbuild/kconfig-language.txt.

config ARC_PLAT_EZNPS
	bool "\"EZchip\" ARC dev platform"
	select CPU_BIG_ENDIAN
	select ARC_HAS_COH_CACHES if SMP
	select CMDLINE_UBOOT
	select EZNPS_NET if ETHERNET
	help
	  Support for ARC development platforms, provided by EZchip.
	  These are based on FPGA or nSIM. e.g.
	  - HE0
	  - HE1
	  - MetaWare nSIM

if ARC_PLAT_EZNPS

config NPS_BOARD_HE0
	bool "NPS HE0"
	help
	  NPS HE0 (Hardware Emulator)
	  This is EZchip Reference Platform.

config NPS_BOARD_HE1
	bool "NPS HE1"
	help
	  NPS HE1 (Hardware Emulator).
	  This is EZchip Reference Platform.

config NPS_NSIM_VIRT_PERIP
	bool "NPS NSIM"
	help
	  NPS Linux can run on ARC simulation.
	  Base upon nSIM as ARC core.

config NPS_SMP_EXTN
	bool "ARC SMP Extensions"
	default y
	select ARC_HAS_IPI
	help
	  SMP Extensions to ARC700.
	  The SMP extensions include:
	  -IDU (Interrupt Distribution Unit)
	  It doesn't provide coherent Caches and/or Atomic Ops (LLOCK/SCOND)
	  We assume only instruction cache coherency.

endif
```

## arch/arc/plat-haps51/Kconfig
```kconfig
#
# Copyright (C) 2012 Synopsys, Inc. (www.synopsys.com)
#
# This program is free software; you can redistribute it and/or modify
# it under the terms of the GNU General Public License version 2 as
# published by the Free Software Foundation.
#

if ARC_PLAT_HAPS51

choice
	prompt "HAPS51 Board Flavours"

config ARC_BOARD_HAPS51
	bool "Basic HAPS51 Board"
	help
	  Synopsys HAPS51 Basic Subsystem FPGA board (Xilinx Virtex-5 Based).

config ARC_MODEL_NSIM_OSCI
	bool "NSIM OSCI System C model"
	help
	  NSIM based System C model. This model is compatible with some of the
	  peripherals that are also used for the HAPS51 FPGA board.

	  OSCI stands for Open SystemC Initiative.

endchoice

if ARC_BOARD_HAPS51

config DW_GPIO
	bool "Designware IP GPIO"
	select DW_INTC
	select GENERIC_GPIO
	select ARCH_REQUIRE_GPIOLIB
	select LEDS_CLASS
	default n
	help
	  Synopsys DesignWare APB GPIO device driver
	  This device gives acces to the buttons and leds
	  of the multi-IO interface extension board.
	  It is dependent on GPIOLIB and LEDS_CLASS

config DW_INTC
	bool "Off-chip Synopsys DW Interrupt Controller"
	default n
	help
	  This is the off-chip (2nd level) Interrupt Controller which can
	  be used to cascade external interrupts. It provides lot of
	  fancy features such as IRQ priority, Masking, Disabling....

endif

config DW_PGU2
	tristate "Use Synopsys DW Pixel Graphics Unit"
	select FB
	select FB_CFB_FILLRECT
	select FB_CFB_COPYAREA
	select FB_CFB_IMAGEBLIT
	help
		Select DW PGU2 which is an alternative for the regular ARC PGU
		This device includes generic software accelerated graphics
		Further more, it contains a double buffered framebuffer
		Be carefull, functionaly it is very much different from ARC PGU

config ARCPGU_YUVBUFS
	int 'Number of YUV Buffers'
	default 18
	depends on PGU_SIM || DW_PGU2

config DWPGU2_RGBBUFS
	int 'Number of RGB Buffers'
	default 2
	depends on DW_PGU2

config ARCPGU_DISPTYPE
	int 'Display selector (0 - VGA, 1 - QVGA)'
	default 0
	depends on PGU_SIM || DW_PGU2

source arch/arc/drivers/Kconfig

endif
```

## arch/arc/plat-tb100/Kconfig
```kconfig
# Abilis Systems: TB100 platform kernel configuration file
# Copyright (C) 2008-2012 Christian Ruppert <christian.ruppert@abilis.com>

menuconfig ARC_PLAT_TB100
	bool "Abilis TB100"
	help
	  Support for platforms based on the TB100 home media gateway SOC by
	  Abilis Systems.

if ARC_PLAT_TB100

config TB100_TUBE_CONSOLE
	bool "Early console on htube"
	default n
	depends on EARLY_PRINTK && ARC_PLAT_TB100
	help
	  Early console on htube for VCS simulation.
	  This functionality is only available in the Abilis RTL simulation
	  environment. Physical implementations in Silicon or FPGA do not
	  provide this type of console.
	  Choose N unless you build this kernel for RTL simulation.

config TB100_EARLY_CONSOLE_BAUD
	int "early serial baud rate"
	default "9600"
	depends on EARLY_PRINTK && ARC_PLAT_TB100

endif
```

## drivers/mtd/aml_nand/Kconfig
```kconfig
#
# Sensor device configuration
#

config AM_NAND
	bool "Amlogic NAND FLASH SUPPORT"
	default y
	select BLOCK
        select MTD_NAND 
	select MTD_PARTITIONS
        select MTD_BLOCK
        select MTD_CHAR
        help
		This is AML8626X NAND support
```

## drivers/staging/cardreader/Kconfig
```kconfig
#
# cardreader subsystem configuration
#

menu "Amlogic Card support"

config CARDREADER
	bool "Card reader support "
	default n

config SD_MMC
	bool "SD/MMC card driver support"
	default y
	depends on CARDREADER

endmenu
```

## drivers/staging/serial/Kconfig
```kconfig
config SERIAL_68360_SMC
	bool "68360 SMC uart support"
	depends on M68360
	help
	  This driver supports the SMC serial ports of the Motorola 68360 CPU.

config SERIAL_68360_SCC
	bool "68360 SCC uart support"
	depends on M68360
	help
	  This driver supports the SCC serial ports of the Motorola 68360 CPU.

config SERIAL_68360
	bool
	depends on SERIAL_68360_SMC || SERIAL_68360_SCC
	default y

config AM_UART
        bool "Amlogic Uart support"
        default y
	select SERIAL_CORE
	select SERIAL_CORE_CONSOLE
        depends on ARC_PLAT_AML8626X
        help
           hardware uart

choice
        prompt "---SET UART0 PORT"
        default AM_UART0_SET_PORT_A

config AM_UART0_SET_PORT_A
        bool "uart port A"
        select SERIAL_CORE
        select SERIAL_CORE_CONSOLE
        help
           DB9 connector is UART 0/ttyS0

config AM_UART0_SET_PORT_B
        bool "uart port B"
        select SERIAL_CORE
        select SERIAL_CORE_CONSOLE
        help
           DB9 connector is UART 1/ttyS1

endchoice
```
